## conf/layer.conf
```bitbake
# We have a conf and classes directory, add to BBPATH
BBPATH .= ":${LAYERDIR}"

# We have recipes-* directories, add to BBFILES
BBFILES += "${LAYERDIR}/recipes-*/*/*.bb \
            ${LAYERDIR}/recipes-*/*/*.bbappend"

BBFILE_COLLECTIONS += "meta-my-rasp"
BBFILE_PATTERN_meta-my-rasp = "^${LAYERDIR}/"
BBFILE_PRIORITY_meta-my-rasp = "10"

LAYERDEPENDS_meta-my-rasp = "core"
LAYERSERIES_COMPAT_meta-my-rasp = "kirkstone"
```
